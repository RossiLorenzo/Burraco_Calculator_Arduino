// Libraries
#include "M5Dial.h"
#include <vector>
#include <algorithm>
#include <random>

// Trophy!
uint16_t Trophy[32 * 32] = {
    0xFFFF, 0xFFFF, 0xFFFF, 0xFFFF, 0xFFFF, 0xFFFF, 0xFFFF, 0xFFFF, 0xFFFF, 0xFFFF, 0xFFFF, 0xFFFF, 0xFFFF, 0xFFFF, 0xFFFF, 0xFFFF, 0xFFFF, 0xFFFF, 0xFFFF, 0xFFFF, 0xFFFF, 0xFFFF, 0xFFFF, 0xFFFF, 0xFFFF, 0xFFFF, 0xFFFF, 0xFFFF, 0xFFFF, 0xFFFF, 0xFFFF, 0xFFFF,
    0xFFFF, 0xFFFF, 0xFFFF, 0xFFFF, 0xFFFF, 0xFFFF, 0xFFFF, 0xFFFF, 0xFFFF, 0xFFFF, 0xFFFF, 0xFFFF, 0xFFFF, 0xFFFF, 0xFFFF, 0xFFFF, 0xFFFF, 0xFFFF, 0xFFFF, 0xFFFF, 0xFFFF, 0xFFFF, 0xFFFF, 0xFFFF, 0xFFFF, 0xFFFF, 0xFFFF, 0xFFFF, 0xFFFF, 0xFFFF, 0xFFFF, 0xFFFF,
    0xFFFF, 0xFFFF, 0xFFFF, 0xFFFF, 0xFFFF, 0xFFFF, 0xFFFF, 0xFFFF, 0xFFFF, 0xFFFF, 0xFFFF, 0xFFFF, 0xFFFF, 0xFFFF, 0xFFFF, 0xFFFF, 0xFFFF, 0xFFFF, 0xFFFF, 0xFFFF, 0xFFFF, 0xFFFF, 0xFFFF, 0xFFFF, 0xFFFF, 0xFFFF, 0xFFFF, 0xFFFF, 0xFFFF, 0xFFFF, 0xFFFF, 0xFFFF,
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    0xFFFF, 0xFFFF, 0xFFFF, 0xFFFF, 0xFFFF, 0xFFFF, 0xFFFF, 0xFFFF, 0xFFFF, 0xFFFF, 0xFFFF, 0xFFFF, 0xFFFF, 0xFFFF, 0xFFFF, 0xFFFF, 0xFFFF, 0xFFFF, 0xFFFF, 0xFFFF, 0xFFFF, 0xFFFF, 0xFFFF, 0xFFFF, 0xFFFF, 0xFFFF, 0xFFFF, 0xFFFF, 0xFFFF, 0xFFFF, 0xFFFF, 0xFFFF,
};

const uint16_t Poo[32 * 32]  = {
  0xffff, 0xffff, 0xffff, 0xffff, 0xffff, 0xffff, 0xffff, 0xffff, 0xffff, 0xffff, 0xffff, 0xffff, 0xffff, 0xffff, 0xffff, 0xffff, 0xffff, 0xffff, 0xffff, 0xffff, 0xffff, 0xffff, 0xffff, 0xffff, 0xffff, 0xffff, 0xffff, 0xffff, 0xffff, 0xffff, 0xffff, 0xffff, 
  0xffff, 0xffff, 0xffff, 0xffff, 0xffff, 0xffff, 0xffff, 0xffff, 0xffff, 0xffff, 0xffff, 0xffff, 0xffff, 0xffff, 0xffff, 0xffff, 0xffff, 0xffff, 0xffff, 0xffff, 0xffff, 0xffff, 0xffff, 0xffff, 0xffff, 0xffff, 0xffff, 0xffff, 0xffff, 0xffff, 0xffff, 0xffff, 
  0xffff, 0xffff, 0xffff, 0xffff, 0xffff, 0xffff, 0xffff, 0xffff, 0xffff, 0xffff, 0xffff, 0xffff, 0xffff, 0xffff, 0xffff, 0xffff, 0xffff, 0xffff, 0xffff, 0xffff, 0xffff, 0xffff, 0xffff, 0xffff, 0xffff, 0xffff, 0xffff, 0xffff, 0xffff, 0xffff, 0xffff, 0xffff, 
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  0xffff, 0xffff, 0xffff, 0xffff, 0xffff, 0xffff, 0xffff, 0xffff, 0xffff, 0xffff, 0xffff, 0xffff, 0xffff, 0xffff, 0xffff, 0xffff, 0xffff, 0xffff, 0xffff, 0xffff, 0xffff, 0xffff, 0xffff, 0xffff, 0xffff, 0xffff, 0xffff, 0xffff, 0xffff, 0xffff, 0xffff, 0xffff
};

// Colors
static const uint16_t tft_colors[] = {
    0x7BEF, // Magenta
    0x1206, // Dark Green
    0x03EF  // Blue
};

// Base Players

static const std::vector<String> player_names = {
  "Lido",
  "Gabriella",
  "Lorenzo",
  "Flavia",
  "Michele",
  "Mariapia",
  "Massimo",
  "Roberta",
  "Altro"
};

// Screens Funnel:
    // Set Up Mode: Pick Players --> Players Name --> Home Page
    // Game Mode: Home Page --> Points P1 --> .. --> Points PN --> Home Page
bool mode_Setup = true;
bool mode_Home = false;
bool mode_Update = false;
bool mode_Completed = false;
bool mode_Completed_First = false;

// Globals
short players = 2;
std::vector<String> selected_players;
std::vector<float> points;
int w;
int h;

// Encoder utility function
short encoder_reader(short minVal, short maxVal, const std::vector<String>& options = std::vector<String>(), String header = "") {
    short oldPosition = -1;
    while (true) {
        // Read current value
        M5Dial.update();
        short newPosition = M5Dial.Encoder.read();

        // Clamp to range
        if (newPosition < minVal){
            M5Dial.Encoder.write(minVal);
            newPosition = minVal;
        }
        if (newPosition > maxVal){
            M5Dial.Encoder.write(maxVal);
            newPosition = maxVal;
        }

        // Print status
        if (newPosition != oldPosition) {
            // M5Dial.Speaker.tone(8000, 20);
            M5Dial.Display.fillScreen(0x1206);

            // Draw header if provided
            if (header.length() > 0) {
                M5Dial.Display.setTextSize(1);
                M5Dial.Display.drawString(header, w/2, h/4);   // Top center
            }

            // Draw main value
            M5Dial.Display.setTextSize(2);
            if (!options.empty()) {
                M5Dial.Display.drawString(options[newPosition], w/2, h/2 + 20);
            } else {
                M5Dial.Display.drawString(String(newPosition), w/2, h/2 + 20);
            }
            oldPosition = newPosition;
        }

        // When user presses BtnA, return current value
        if (M5Dial.BtnA.wasPressed()) {
            M5Dial.Encoder.write(0);
            return newPosition;
        }
    }
}

String formatPoints(float value) {
    return String(int(round(value)));
}

void playVictoryTune() {
    int notes[][2] = {
        {5230, 150}, // C5
        {6590, 150}, // E5
        {7840, 150}, // G5
        {10470, 300}, // C6 (higher C)
        {8800, 200}, // A5
        {9880, 400}  // B5
    };

    for (int i = 0; i < 6; i++) {
        M5Dial.Speaker.tone(notes[i][0], notes[i][1]);
        delay(notes[i][1] + 30); // small gap
    }
}

void pooFlavia() {
    std::random_device rd;
    std::mt19937 gen(rd());
    std::uniform_int_distribution<> distrib(0, 210);
    for (int j = 0; j < 20; j++) {
        M5Dial.Display.drawBitmap(distrib(gen), distrib(gen), 32, 32, Poo);
        delay(30);
    }
}

// Function to write the UI
void write_ui(){
    float arcSize = 360 / players;
    for (int i = 0; i < players; i++) {
        float midAngleRad = (i * arcSize + arcSize/2 - 90) * DEG_TO_RAD;
        M5Dial.Display.fillArc(w/2, h/2, h/2, 0, i * arcSize - 90, (i+1) * arcSize - 90, tft_colors[i]);        
        // Print Player Names
        if(players == 2){
            // Print Players
            M5Dial.Display.setTextSize(1);
            int slashPos = selected_players[i].indexOf('/');
            if (slashPos != -1) {
                String p1 = selected_players[i].substring(0, slashPos);
                String p2 = selected_players[i].substring(slashPos + 1);
                M5Dial.Display.drawString(p1, w/2 + 0.25*(w/2)*cos(midAngleRad), h/4);
                M5Dial.Display.drawString(p2, w/2 + 0.25*(w/2)*cos(midAngleRad), 3*h/4);
            } else {
                M5Dial.Display.drawString(selected_players[i], w/2 + 0.6*(w/2)*cos(midAngleRad), h/4);
            }
            // Print Points
            M5Dial.Display.setTextSize(2);
            M5Dial.Display.drawString(formatPoints(points[i]), w/2 + 0.5*(w/2)*cos(midAngleRad), h/2);
        } else {
            // Hardcode positions because trigonometric is fucking annoying
            short tmp_name_x;
            short tmp_name_y;
            short tmp_points_x;
            short tmp_points_y;
            if(i == 0){
                tmp_name_x = w/2+30; tmp_name_y = 30;
                tmp_points_x = 3*w/4; tmp_points_y = 1*h/3+20;
            }
            if(i == 1){
                tmp_name_x = 120; tmp_name_y = 216;
                tmp_points_x = w/2; tmp_points_y = 2*h/3+20;
            }
            if(i == 2){
                tmp_name_x = w/2-30; tmp_name_y = 30;
                tmp_points_x = w/4; tmp_points_y = 1*h/3+20;
            }
            M5Dial.Display.setTextSize(1);
            M5Dial.Display.drawString(selected_players[i], tmp_name_x, tmp_name_y);
            M5Dial.Display.setTextSize(2);
            M5Dial.Display.drawString(formatPoints(points[i]),tmp_points_x, tmp_points_y); 
        }
    }
}

// Set-Up
void setup() {
    Serial.println("Starting Set-Up");

    // Generic Set-Up
    auto cfg = M5.config();
    M5Dial.begin(cfg, true, false);
    Serial.begin(9600);

    // Height and Width
    w = M5Dial.Display.width();
    h = M5Dial.Display.height();

    // Print base text
    M5Dial.Display.fillScreen(0x1206);
    M5Dial.Display.setTextColor(0xFFFF);
    M5Dial.Display.setTextDatum(middle_center);
    M5Dial.Display.setTextFont(&fonts::Roboto_Thin_24);
    M5Dial.Encoder.write(2);
}

// Loop
void loop() {
    // Set Up Mode: Pick Players --> Players Name --> Home Page
    if(mode_Setup){
        // Define number of players
        Serial.println("Set up - Number of players");
        players = encoder_reader(2, 4, {}, "# Giocatori");
        // Select player names and set all points to 0
        Serial.println("Set up - Player names");
        std::vector<String> available_players = player_names; 
        std::vector<String> hd;
        if(players == 4){
            hd = {"Squadra 1", "Squadra 1", "Squadra 2", "Squadra 2"};
        } else {
            for (int i = 0; i < players; i++) {
                hd.push_back("Giocatore " + String(i + 1));
            }
        }
        selected_players.clear();
        points.clear();
        for (int i = 0; i < players; i++) {
            short selected_player_index = encoder_reader(0, available_players.size() - 1, available_players, hd[i]);
            String p = available_players[selected_player_index].substring(0, 3);
            if(available_players[selected_player_index] == "Flavia"){
                pooFlavia();
            }
            p.toUpperCase();
            selected_players.push_back(p);
            available_players.erase(available_players.begin() + selected_player_index);
            points.push_back(0);
        }
        // Adjust for 4 players
        if(players == 4){
            std::vector<String> temp_players = selected_players;
            selected_players.clear();
            players = 2;
            selected_players.push_back(temp_players[0] + "/" + temp_players[1]);
            selected_players.push_back(temp_players[2] + "/" + temp_players[3]);
        }
        // Base UI
        Serial.println("Set up - UI");
        write_ui();
        // Set Up Completed
        mode_Setup = false;
        mode_Home = true;
    }

    // Home Mode: Home Page --> Do you want to update?
    if(mode_Home){
        M5Dial.update();
        if (M5Dial.BtnA.wasPressed()) {
            M5Dial.Encoder.write(0);
            std::vector<String> options = {"Si", "No"};
            short round_update = encoder_reader(0, 1, options, "Aggiorna Punti?");
            if (round_update == 1) {
                write_ui();
            } else {
                mode_Home = false;
                mode_Update = true;
            }
        }
        delay(50);
    }

    // Update Mode: Points P1, ..., Points Pn --> Home
    if(mode_Update){
        Serial.println("Update Menu");
        bool update_completed = false;
        short run_winner_index;
        // Set-up round points
        std::vector<float> round_points;
        std::vector<String> explain_points;
        while(!update_completed){
            // Who won the round?
            Serial.println("Chiusura");
            run_winner_index = encoder_reader(0, players-1, selected_players, "Chi ha chiuso?");
            // Adjust for 3 players
            short tmp_players = players;
            short tmp_run_winner_index = run_winner_index;
            std::vector<String> tmp_selected_players = selected_players;
            if(players == 3){
                tmp_players = 2;
                tmp_selected_players.erase(tmp_selected_players.begin() + run_winner_index);
                String team1 = selected_players[run_winner_index];
                String team2 = tmp_selected_players[0] + "/" + tmp_selected_players[1];
                tmp_run_winner_index = 0;
                tmp_selected_players.clear();
                tmp_selected_players.push_back(team1);
                tmp_selected_players.push_back(team2);
            }
            // Set-up round points
            round_points.clear();
            for (int i = 0; i < tmp_players; i++) {
                if(i == tmp_run_winner_index){
                    round_points.push_back(100);
                    explain_points.push_back("100");
                } else{
                    round_points.push_back(0);
                    explain_points.push_back("");
                }
            }
            // Pagati
            Serial.println("Pagati");
            short punti_pagati;
            for (int i = 0; i < tmp_players; i++) {
                if(i != tmp_run_winner_index){
                    std::vector<String> increments_5;
                    for (int j = 0; j <= 2000; j = j + 5) {
                        increments_5.push_back("-" + String(j));
                    }
                    punti_pagati = encoder_reader(0, 2000/5, increments_5, "Pagati: " + tmp_selected_players[i]);
                    explain_points[i] += " -" + formatPoints(punti_pagati * 5);
                    round_points[i] -= punti_pagati * 5;
                }
            }
            // Base
            Serial.println("Base");
            short punti_base;
            for (int i = 0; i < tmp_players; i++) {
                std::vector<String> increments_50;
                for (int j = -100; j <= 2000; j = j + 50) {
                    increments_50.push_back(String(j));
                }
                if(i == tmp_run_winner_index){
                    punti_base = encoder_reader(2, 2100/50, increments_50, "Base: " + tmp_selected_players[i]);
                }else{
                    punti_base = encoder_reader(0, 2100/50, increments_50, "Base: " + tmp_selected_players[i]);
                }
                explain_points[i] += ((-100 + punti_base * 50) < 0) ? " " : " +" + formatPoints(-100 + punti_base * 50);
                round_points[i] += -100 + punti_base * 50;
            }
            // Fatti
            Serial.println("Fatti");
            short punti_fatti;
            for (int i = 0; i < tmp_players; i++) {   
                std::vector<String> increments_5_2;            
                for (int j = -2000; j <= 2000; j = j + 5) {
                    increments_5_2.push_back(String(j));
                }
                M5Dial.Encoder.write(2200/5);
                punti_fatti = encoder_reader(0, 4000/5, increments_5_2, "Fatti: " + tmp_selected_players[i]);
                explain_points[i] += ((punti_fatti * 5 - 2000) < 0) ? " " : " +" + formatPoints(punti_fatti * 5 - 2000);
                round_points[i] += punti_fatti * 5 - 2000;
            }
            // Risultati
            M5Dial.Display.clear();
            for (int i = 0; i < tmp_players; i++) {
                M5Dial.Display.setTextSize(1.2);
                M5Dial.Display.drawString(tmp_selected_players[i] + ": " + formatPoints(round_points[i]), h/2, 60 + i*80);
                M5Dial.Display.setTextSize(1);
                M5Dial.Display.drawString("(" + explain_points[i] + ")", h/2, 90 + i*80);
                M5Dial.Display.setTextSize(1);
            }
            M5Dial.update();
            while(!M5Dial.BtnA.wasPressed()) {
                delay(50);
                M5Dial.update();
            }
            std::vector<String> options = {"Si", "No"};
            M5Dial.Encoder.write(0);
            short tmp_completed = encoder_reader(0, 1, options, "Corretto?");
            if(tmp_completed == 0){
                update_completed = true;
            }
        }

        // Calculation completed, return to home or to completed
        // Aggiorna punteggio
        if(players == 3){
            for (int i = 0; i < players; i++) {
                if(i == run_winner_index){
                    points[run_winner_index] += round_points[0];
                } else{
                    points[i] += round_points[1]/2;
                }
            }
        } else{
            for (int i = 0; i < players; i++) {
                points[i] += round_points[i];
            }
        }

        // Check if completed 
        float max_points = *std::max_element(points.begin(), points.end());

        if(max_points < 2005){
            write_ui();
            delay(50);
            mode_Home = true;
            mode_Update = false;
        }
        else{
            mode_Completed = true;
            mode_Completed_First = true;
            mode_Update = false;
        }
    }

    if(mode_Completed){
        if(mode_Completed_First){
            M5Dial.Display.clear();
            for (int y = 0; y < h; y = y + 32) {
                for (int x = 0; x < w; x = x + 32) {
                    M5Dial.Display.drawBitmap(x, y, 32, 32, Trophy);
                    delay(30);
                }
            }
            playVictoryTune();
            delay(500);
            M5Dial.Display.clear();
            M5Dial.Display.fillScreen(TFT_GOLD);
            M5Dial.Display.setTextSize(1);
            M5Dial.Display.drawString("Vittoria!", w/2, h/4);
            M5Dial.Display.setTextSize(2);
            auto it = std::max_element(points.begin(), points.end());
            int max_index = std::distance(points.begin(), it);
            M5Dial.Display.drawString(selected_players[max_index], h/2, w/2);
            delay(5000);
            M5Dial.Display.setTextColor(0xFFFF);
            mode_Completed_First = false;
        }
        write_ui();
        delay(60000);
    }
}